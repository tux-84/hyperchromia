## build/package/hyperhdr/Config.in
```kconfig
config BR2_PACKAGE_HYPERHDR
	bool "hyperhdr"
	depends on BR2_TOOLCHAIN_HAS_THREADS
	depends on BR2_INSTALL_LIBSTDCPP
	depends on !BR2_STATIC_LIBS
	depends on BR2_PACKAGE_QT6_ARCH_SUPPORTS
	select BR2_PACKAGE_QT6
	select BR2_PACKAGE_QT6BASE
	select BR2_PACKAGE_QT6BASE_NETWORK
	select BR2_PACKAGE_QT6SERIALPORT
	select BR2_PACKAGE_JPEG
	select BR2_PACKAGE_JPEG_TURBO
	select BR2_PACKAGE_OPENSSL
	select BR2_PACKAGE_DBUS
	select BR2_PACKAGE_ALSA_LIB
	select BR2_PACKAGE_LIBUSB
	select BR2_PACKAGE_AVAHI
	select BR2_PACKAGE_AVAHI_DAEMON
	select BR2_PACKAGE_AVAHI_LIBAVAHI_CLIENT
	select BR2_PACKAGE_FLATBUFFERS
	help
	  HyperHDR is an open source ambient lighting implementation
	  that captures HDMI video (via a USB/UVC capture device and
	  V4L2) and drives LED hardware over the network.

	  Headless appliance build: V4L2 capture backend only,
	  X11/PipeWire/systray/CEC/MQTT disabled, embedded web UI.

	  https://github.com/awawa-dev/HyperHDR
```
